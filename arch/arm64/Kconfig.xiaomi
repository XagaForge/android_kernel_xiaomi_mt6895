## arch/arm64/Kconfig.xiaomi
```kconfig
# SPDX-License-Identifier: GPL-2.0-only

config TARGET_PRODUCT_ARISTOTLE
    bool "Product Name Aristotle"
    default n
    help
    Product Name Aristotle.

config TARGET_PRODUCT_PLATO
	bool "Product Name Plato"
	default n
	help
	Product Name Plato.

config TARGET_PRODUCT_RUBENS
	bool "Product Name Rubens"
	default n
	help
	Product Name Rubens.

config TARGET_PRODUCT_XAGA
	bool "Product Name Xaga"
	default n
	help
	Product Name Xaga.

config BUILD_PRODUCT_NAME
	string "Product Name"
	help
	Product Name.
```

## drivers/power/supply/mediatek/Kconfig
```kconfig
# SPDX-License-Identifier: GPL-2.0
config BATTERY_MT6359P
	tristate "MT6359P fuel gauge support"
	depends on MFD_MT6397
	default m
	help
	  Say Y to enable support for MT6359P battery driver.
	  it measure battery current and temperature to provide
	  battery information , It issues interrupt when trigger
	  threshold is met.

config CHARGER_MT6360
	tristate "Mediatek MT6360 Charger Driver"
	depends on MFD_MT6360
	depends on REGULATOR
	select EXTCON
	help
	  Say Y here to enable MT6360 Charger Part.
	  support High-Accuracy Voltage/Current Regulation,
	  Average Input Current Regulation, Battery Tempature Sensing,
	  Over-Temperature Protection, DPDM Detection for BC1.2

config CHARGER_MT6362
	tristate "MT6362 SPMI CHG driver"
	depends on MFD_MT6362
	help
	  Say yes here to have support for the MT6362 CHG
	  It supports BC1.2 and OTG boost.
	  The driver can also be build as a module.
	  If so, the module will be called mt6362_chg

config CHARGER_MT6375
	tristate "MT6375 charger driver"
	depends on MFD_MT6375
	help
	  Say Y to enable support for the MT6375 charger.
	  The driver supports controlling switching charger and OTG
	  with high-accuracy current and voltage regulation.
	  The device is compliant with the USB Battery Charging Specification
	  Revision 1.2.

config GAUGE_MT6375
	tristate "MT6375 fuel gauge driver"
	depends on MFD_MT6375
	help
	  This adds support for battery fuel gauge in Mediatek MT6375 PMIC.
	  The fuelgauge calculates and determines the battery state of charge
	  according to battery open circuit voltage.

config MTK_CHARGER_TYPE_DETECT
	tristate "Mediatek Charger Type Detect Driver"
	depends on TCPC_CLASS
	help
	  Say Y here to enable Mediatek Charger Type Detect.
	  Support enable charger type detect when receiving
	  typec attach notify.
	  Say N to disable.

config MTK_CHARGER
	tristate "MediaTek Charging Driver"
	help
	  Say yes here to enable MediaTek charging driver.
	  This driver contains charging control flow and
	  maintains charging status.
	  Say no if not using MediaTek charging driver.

config XMUSB350_CHARGER_DET
	tristate "xmusb350 qc charger type detect"
	help
	  Say yes here to enable xmusb350 qc charger type detect driver.
	  Say no if not using xmusb350 qc charger type detect driver.

config XMEXT_TI_GAUGE
	tristate "xmext use bq28z601 gauge"
	help
	  Say yes here to enable xmext use bq28z601 gauge driver.
	  Say no if not using xmext use bq28z601 gauge driver.

config XMEXT_CHG_PUMP
	tristate "xmext use sc8561 charger_pump"
	help
	  Say yes here to enable xmext use sc8561 charger_pump driver.
	  Say no if not using xmext use sc8561 charger_pump driver.

config XMEXT_SC8551A_CHG_PUMP
	tristate "xmext use sc8551A charger_pump"
	help
	  Say yes here to enable xmext use sc8551A charger_pump driver.
	  Say no if not using xmext use sc8551A charger_pump driver.

config XMEXT_LN8000_CHG_PUMP
	tristate "xmext use ln8000 charger_pump"
	help
	  Say yes here to enable xmext use ln8000 charger_pump driver.
	  Say no if not using xmext use ln8000 charger_pump driver.

config XM_PD_MANAGER
	tristate "pd_cp_manager contral pd adapter charging"
	help
	  Say yes here to enable pd_cp_manager contral pd adapter charging driver.
	  Say no if not using pd_cp_manager contral pd adapter charging driver.

config XM_QC_MANAGER
	tristate "qc_cp_manager contral qc adapter charging"
	help
	  Say yes here to enable qc_cp_manager contral qc adapter charging driver.
	  Say no if not using qc_cp_manager contral qc adapter charging driver.

config MTK_PUMP_EXPRESS_PLUS_SUPPORT
	tristate "MediaTek PUMP EXPRESS PLUS"
	depends on MTK_CHARGER
	help
	  Fast charging technology using switch charger and current pattern
	  to achive better charging ability.
	  Set Yes to enable PE+
	  Set No to disable PE+

config MTK_PUMP_EXPRESS_PLUS_20_SUPPORT
	tristate "MediaTek PUMP EXPRESS PLUS 2.0"
	depends on MTK_CHARGER
	help
	  Fast charging technology using switch charger and current pattern
	  to achive better charging ability. It has higher charging efficiency
	  and has better thermal performance than PE+.
	  Set Yes to enable PE+2.0
	  Set No to disable PE+2.0

config MTK_PUMP_EXPRESS_40_SUPPORT
	tristate "MediaTek PUMP EXPRESS 4.0"
	depends on MTK_CHARGER
	help
	  Fast charging technology supports request adjustments of source output
	  voltage in increments as small as 50 mV to achive better charging ability.
	  It has higher charging efficiency and has better thermal performance than
	  PE+/PE+2.0.
	  Set Yes to enable PE 4.0
	  Set No to disable PE 4.0

config MTK_PUMP_EXPRESS_50_SUPPORT
	tristate "MediaTek PUMP EXPRESS 5.0"
	depends on MTK_CHARGER
	help
	  Fast charging technology using divider charger
	  to achive better charging ability. It has higher charging efficiency
	  and has better thermal performance than PE+.
	  Set Yes to enable PE 5.0
	  Set No to disable PE 5.0

config CHARGER_RT9759
	tristate "Charger Driver for Richtek RT9759 Charger IC"
	default n
	depends on MTK_CHARGER
	help
	  Say Yes to enable Richtek RT9759 driver.
	  It is mainly used as cap divider charger
	  for Mediatek Pump Express 5.0.
	  It depends on config MTK_CHARGER
```
