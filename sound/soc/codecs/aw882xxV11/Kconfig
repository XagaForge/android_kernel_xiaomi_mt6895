## sound/soc/codecs/aw882xxV11/Kconfig
```kconfig
config SND_SMARTPA_AW882XX_V11
	tristate "SoC Audio for awinic aw882xxseries"
	depends on I2C
	help
			Enable support for awinic aw882xx series smart PA.

config SND_SMARTPA_AW882XX_GPIO_CONFIG_V11
	tristate "SoC Audio for awinic aw882xxseries config reset GPIO"
	depends on I2C
	help
			Enable GPIO configuration for awinic aw882xx series reset.
```
